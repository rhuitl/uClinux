## config/Kconfig
```kconfig
#############################################################################

#
#	Kconfig - user space configuration
#

#############################################################################

mainmenu "Linux Application Configuration"

config DISTVERSION
	string
	default "4.0"

source ../vendors/Kconfig

source ../lib/Kconfig
menu "Automake Libraries"
source ../lib/Kconfig.auto
endmenu



source ../user/Kconfig
menu "Automake Applications"
source ../user/Kconfig.auto
endmenu

#############################################################################
```

## glibc/Kconfig
```kconfig
#############################################################################
#
#	Kconfig - library configuration
#
#############################################################################

menu "glibc Library Configuration (if selected)"

choice
	prompt "Which glibc version ?"
	default GLIBC_2_3_6
	depends on DEFAULTS_LIBC_GLIBC
	help
	  Select which glibc you want your system to use.

config GLIBC_2_3_6
	bool "glibc-2.3.6"
	help
		glibc version 2.3.6

config GLIBC_2_5
	bool "glibc-2.5"
	help
		glibc version 2.5

endchoice

endmenu

#############################################################################
```

## lib/Kconfig
```kconfig
#############################################################################

#
#	Kconfig - library configuration
#

#############################################################################

menu "Library Configuration"

comment "Force build (normally built when required)"

config LIB_BITVECTOR
	bool "Build bit vector"
	default n
	help
	  BitVector support.
	  Only enable this if you want to force the library to be built.
	  The Config will make sure this library is built if it is needed.

config LIB_FLEX
	bool "Build flex"
	default n

config LIB_BFD
	bool "Build libbfd"
	default n

config LIB_LIBIBERTY
	bool "Build libiberty"
	default n

config LIB_POPT
	bool "Build libpopt"
	default n

config LIB_LIBSSL
	bool "Build libSSL"
	default n
	help
	  SSL library.
	  Only enable this if you want to force the library to be built.
	  The Config will make sure this library is built if it is needed.

config LIB_LIBGMP
	bool "Build libGMP"
	default n
	help
	  GMP Library.
	  Only enable this if you want to force the library to be built.
	  The Config will make sure this library is built if it is needed.

config LIB_LIBG
	bool "Build libG"
	default n

config LIB_LIBKRB5
	bool "Build MIT Kerberos Library"
	default n

config LIB_CYRUSSASL
	bool "Cyrus SASL library"
	select LIB_LIBKRB5
	default n

config LIB_LIBLDAP
	bool "Build libldap"
	select LIB_CYRUSSASL
	default n
	help
	  OpenLDAP Library.
	  Only enable this if you want to force the library to be built.
	  The Config will make sure this library is built if it is needed.

config LIB_LIBLZMA
	bool "Build liblzma"
	default n

config LIB_LIBLZO
	bool "Build liblzo"
	default n

config LIB_LIBNET
	bool "Build libnet"
	default n
	help
	  Archaic version of libnet required for snort inline operation.
	  See: http://www.packetfactory.net/libnet/
	  Only enable this if you want to force the library to be built.  The
	  Config will make sure this library is built if it is needed.

config LIB_LIBNETOLD
	bool "Build really old libnet"
	default n

config LIB_LIBPAM
	bool "Build libPAM"
	default n

config USER_PAM_LDAP
	bool "PAM LDAP"
	depends on LIB_LIBPAM
	select LIB_LIBLDAP
	help
	  PAM should support LDAP authentication.

config USER_PAM_RADIUS
	bool "PAM RADIUS"
	depends on LIB_LIBPAM
	help
	  PAM should support RADIUS authentication.

config USER_PAM_SMB
	bool "PAM SMB"
	depends on LIB_LIBPAM
	help
	  PAM should support SMB authentication.

config USER_PAM_TACACS
	bool "PAM TACACS+"
	depends on LIB_LIBPAM
	help
	  PAM should support TACACS authentication.

config USER_PAM_KRB5
	bool "PAM Kerberos 5"
	depends on LIB_LIBPAM
	select LIB_LIBKRB5
	help
	  PAM should support Kerberos 5 authentication.

config LIB_LIBPCAP
	bool "Build libPCAP"
	default n

config LIB_LIBPCRE
	bool "Build libPCRE"
	default n
	help
	  Perl Compatible Regular Expressions library.
	  Only enable this if you want to force the library to be built.
	  The Config will make sure this library is built if it is needed.

config LIB_ZLIB
	bool "Build libZ"
	default n
	help
	  Data compression library.
	  Only enable this if you want to force the library to be built.
	  The Config will make sure this library is built if it is needed.

config LIB_LIBBZ2
	bool "Build libBZIP2"
	default n
	help
	  Data compression library.
	  Only enable this if you want to force the library to be built.
	  The Config will make sure this library is built if it is needed.

config LIB_LIBATM
	bool "Build libATM"
	default n
	help
	  ATM support library.
	  Only enable this if you want to force the library to be built.
	  The Config will make sure this library is built if it is needed.

config LIB_LIBPNG
	bool "Build libpng"
	select LIB_ZLIB
	default n

config LIB_LIBJPEG
	bool "Build libjpeg"
	default n

config LIB_LIBUPNP
	bool "Build libupnp"
	default n
	help
	  UPnP support library.
	  Only enable this if you want to force the library to be built.
	  The Config will make sure this library is built if it is needed.

config LIB_LIBSYSFS
	bool "Build libsysfs"
	default n

config LIB_NCURSES
	bool "Build ncurses"
	default n
	help
	  CRT screen handling library.
	  Only enable this if you want to force the library to be built.
	  The Config will make sure this library is built if it is needed.

config LIB_TERMCAP
	bool "Build termcap"
	default n

config LIB_LIBEFENCE
	bool "Build libefence"
	default n

config LIB_EXPAT
	bool "Build expat"
	default n
	help
	  Force libexpat to be built.

config LIB_ADNS
	bool "Build adns"
	default n
	help
	  An asyncrhonous resolver with more features than the uClibc resolver.

config LIB_ARES
	bool "Build libares"
	default n
	help
	  An asynchronous resolver with more features than the uClibc resolver.

config LIB_LIBIDN
	bool "Build libidn"
	default n
	help
	  GNU libidn the internationalised domain name resolver.

config LIB_LIBNL
	bool "Build libnl"
	default n

config LIB_LIBNL_COMPONENTS
	bool "Select libnl components"
	depends on LIB_LIBNL
	default n

config LIB_LIBNL_RTNL
	bool "Include libnl rtnl support"
	depends on LIB_LIBNL_COMPONENTS
	default n

config LIB_LIBNL_ROUTE_ADDR
	bool "Include libnl addr support"
	depends on LIB_LIBNL_RTNL
	default n

config LIB_LIBNL_ROUTE_LINK
	bool "Include libnl link support"
	depends on LIB_LIBNL_RTNL
	default n

config LIB_LIBNL_ROUTE_NEIGH
	bool "Include libnl neigh support"
	depends on LIB_LIBNL_RTNL
	default n

config LIB_LIBNL_ROUTE_ROUTE
	bool "Include libnl route support"
	depends on LIB_LIBNL_RTNL
	default n

config LIB_LIBNL_ROUTE_RULE
	bool "Include libnl rule support"
	depends on LIB_LIBNL_RTNL
	default n

config LIB_LIBNL_ROUTE_TC
	bool "Include libnl tc support"
	depends on LIB_LIBNL_RTNL
	default n

config LIB_LIBNL_GENERIC
	bool "Include libnl generic support"
	depends on LIB_LIBNL_COMPONENTS
	default n

config LIB_LIBNL_FIB
	bool "Include libnl fib support"
	depends on LIB_LIBNL_COMPONENTS
	default n

config LIB_LIBNL_NETFILTER
	bool "Include libnl netfilter support"
	depends on LIB_LIBNL_COMPONENTS
	default n

config LIB_LIBNL_NETFILTER_CT
	bool "Include libnl netfilter conntrack support"
	depends on LIB_LIBNL_NETFILTER
	default n

config LIB_LIBNL_NETFILTER_LOG
	bool "Include libnl netfilter log support"
	depends on LIB_LIBNL_NETFILTER
	default n

config LIB_LIBNL_NETFILTER_QUEUE
	bool "Include libnl netfilter queue support"
	depends on LIB_LIBNL_NETFILTER
	default n

config LIB_NFNETLINK
	bool "Build libnfnetlink"
	default n

config LIB_NETFILTER_CONNTRACK
	bool "Build libnetfilter_conntrack"
	select LIB_NFNETLINK
	default n

config LIB_NETFILTER_LOG
	bool "Build libnetfilter_log"
	select LIB_NFNETLINK
	default n

config LIB_OSIP2
	bool "Build libosip2"
	default n

config LIB_LIBCURL
	bool "Build curl"
	select LIB_LIBIDN
	select LIB_ZLIB
	select LIB_LIBBZ2
	select LIB_LIBSSL
	default n
	help
	  The curl library for resolving URLs.
	  This library requires (and enables) SSL, zlib and libidn.

config LIB_LIBCRYPT_OLD
	bool "Build libcrypt_old"
	default n

config LIB_PWLIB
	bool 'Build pwlib'
	select LIB_STLPORT
	help
	  Portable Windows libaray.
	  Only enable this if you want to force the library to be built.  The
	  Config will make sure this library is built if it is needed.

config LIB_LIBOPENH323
	bool 'Build libopenh323'
	select LIB_PWLIB
	select LIB_STLPORT
	help
	  Open H.323 (VoIP) library.
	  Only enable this if you want to force the library to be built.  The
	  Config will make sure this library is built if it is needed.

config LIB_LIBJUDY
	bool 'Build libjudy'
	default n
	help
	  Judy array library.
	  Only enable this if you want to force the library to be built.  The
	  Config will make sure this library is built if it is needed.

 config LIB_LIBJUDY_TESTS
 	bool 'Build libjudy tests'
	depends on LIB_LIBJUDY
	default n
	help
	  Builds the libjudy tests.  These are installed in /bin and
	  the required file StringCompare.c in /etc.  To manually
	  execute the tests look at the tests/Checkit script.

config LIB_CLASSPATH
	bool 'Build classpath'
	default n
	help
	  Clean room standard Java libraries
	  Only enable this if you want to force the library to be built.
	  The Config will make sure this library is built if it is needed.

config LIB_LIBFFI
	bool 'Build libffi'
	default n
	help
	  Foreign Function Interface library
	  Only enable this if you want to force the library to be built.
	  The Config will make sure this library is built if it is needed.

config LIB_LIBXML2
	bool 'Build libxml2'
	default n
	help
	  Library to access XML files.
	  See  http://xmlsoft.org/

comment "Library Configuration"

config LIB_UC_LIBC_TIMEZONE
	bool "Support time zones"
	help
	  Enable this if you want simpleinit to set the time zone environment
	  variables on system startup.  This option also forces uC-libc to
	  support time zone information.  Without this, UTC will be the assumed
	  time zone when using uC-libc.

config LIB_UC_LIBC_TZ_FROM_FILE
	bool "Always load from file"
	depends on LIB_UC_LIBC_TIMEZONE
	help
	  Enable this if you want uC-libc to always read the TZ file for its
	  itme zone information instead of relying on the environment variable
	  set up by init during system boot.  This means that changes to the
	  time zone take effect immediately instead of requiring a reboot.

endmenu

#############################################################################
```

## lib/STLport/Kconfig
```kconfig
config LIB_STLPORT
	bool "Build STLport"
	default n
	help
	  A replacement to libstdc++.  It is smaller than the gcc version.

config LIB_STLPORT_SHARED
	bool "Build STLport as shared"
	depends on LIB_STLPORT
	help
	  Build a shared library version of libstdc++.
```

## lib/cryptopp/Kconfig
```kconfig
config LIB_CRYPTOPP
	bool "Build Crypto++ Library"
	default n
	help
	  Crypto++ Library is a free C++ class library of cryptographic schemes.
```

## lib/libcurl/Kconfig
```kconfig
config LIB_LIBCURL
	bool "Build curl"
	select LIB_LIBIDN
	select LIB_ZLIB
	select LIB_LIBBZ2
	select LIB_LIBSSL
	default n
	help
	  The curl library for resolving URLs.
	  This library requires (and enables) SSL, zlib and libidn.
```

## openswan/linux/net/ipsec/alg/Config.in
```kconfig
#Placeholder
source ../openswan/linux/net/ipsec/alg/Config.alg_aes.in
source ../openswan/linux/net/ipsec/alg/Config.alg_cryptoapi.in
```

## user/busybox/console-tools/Kconfig
```kconfig
#
# For a description of the syntax of this configuration file,
# see scripts/kbuild/config-language.txt.
#

menu "Console Utilities"

config USER_BUSYBOX_CHVT
	bool "chvt"
	default n
	help
	  This program is used to change to another terminal.
	  Example: chvt 4 (change to terminal /dev/tty4)

config USER_BUSYBOX_CLEAR
	bool "clear"
	default n
	help
	  This program clears the terminal screen.

config USER_BUSYBOX_DEALLOCVT
	bool "deallocvt"
	default n
	help
	  This program deallocates unused virtual consoles.

config USER_BUSYBOX_DUMPKMAP
	bool "dumpkmap"
	default n
	help
	  This program dumps the kernel's keyboard translation table to
	  stdout, in binary format. You can then use loadkmap to load it.

config USER_BUSYBOX_KBD_MODE
	bool "kbd_mode"
	default n
	help
	  This program reports and sets keyboard mode.

config USER_BUSYBOX_LOADFONT
	bool "loadfont"
	default n
	help
	  This program loads a console font from standard input.

config USER_BUSYBOX_LOADKMAP
	bool "loadkmap"
	default n
	help
	  This program loads a keyboard translation table from
	  standard input.

config USER_BUSYBOX_OPENVT
	bool "openvt"
	default n
	help
	  This program is used to start a command on an unused
	  virtual terminal.

config USER_BUSYBOX_RESET
	bool "reset"
	default n
	help
	  This program is used to reset the terminal screen, if it
	  gets messed up.

config USER_BUSYBOX_RESIZE
	bool "resize"
	default n
	help
	  This program is used to (re)set the width and height of your current
	  terminal.

config USER_BUSYBOX_FEATURE_RESIZE_PRINT
	bool "Print environment variables"
	default n
	depends on USER_BUSYBOX_RESIZE
	help
	  Prints the newly set size (number of columns and rows) of
	  the terminal.
	  E.g.:
	  COLUMNS=80;LINES=44;export COLUMNS LINES;

config USER_BUSYBOX_SETCONSOLE
	bool "setconsole"
	default n
	help
	  This program redirects the system console to another device,
	  like the current tty while logged in via telnet.

config USER_BUSYBOX_FEATURE_SETCONSOLE_LONG_OPTIONS
	bool "Enable long options"
	default n
	depends on USER_BUSYBOX_SETCONSOLE && USER_BUSYBOX_GETOPT_LONG
	help
	  Support long options for the setconsole applet.

config USER_BUSYBOX_SETKEYCODES
	bool "setkeycodes"
	default n
	help
	  This program loads entries into the kernel's scancode-to-keycode
	  map, allowing unusual keyboards to generate usable keycodes.

config USER_BUSYBOX_SETLOGCONS
	bool "setlogcons"
	default n
	help
	  This program redirects the output console of kernel messages.

endmenu
```
