## user/busybox/loginutils/Kconfig
```kconfig
#
# For a description of the syntax of this configuration file,
# see scripts/kbuild/config-language.txt.
#

menu "Login/Password Management Utilities"

config USER_BUSYBOX_FEATURE_SHADOWPASSWDS
	bool "Support for shadow passwords"
	default n
	help
	  Build support for shadow password in /etc/shadow.  This file is only
	  readable by root and thus the encrypted passwords are no longer
	  publicly readable.

config USER_BUSYBOX_USE_BB_SHADOW
	bool "Use busybox shadow password functions"
	default y
	depends on USER_BUSYBOX_USE_BB_PWD_GRP && USER_BUSYBOX_FEATURE_SHADOWPASSWDS
	help
	    If you leave this disabled, busybox will use the system's shadow
	    password handling functions.  And if you are using the GNU C library
	    (glibc), you will then need to install the /etc/nsswitch.conf
	    configuration file and the required /lib/libnss_* libraries in
	    order for the shadow password functions to work.  This generally
	    makes your embedded system quite a bit larger.

	    Enabling this option will cause busybox to directly access the
	    system's /etc/shadow file when handling shadow passwords.  This
	    makes your system smaller and I will get fewer emails asking about
	    how glibc NSS works).  When this option is enabled, you will not be
	    able to use PAM to access shadow passwords from remote LDAP
	    password servers and whatnot.

config USER_BUSYBOX_USE_BB_PWD_GRP
	bool "Use internal password and group functions rather than system functions"
	default n
	help
	    If you leave this disabled, busybox will use the system's password
	    and group functions.  And if you are using the GNU C library
	    (glibc), you will then need to install the /etc/nsswitch.conf
	    configuration file and the required /lib/libnss_* libraries in
	    order for the password and group functions to work.  This generally
	    makes your embedded system quite a bit larger.

	    Enabling this option will cause busybox to directly access the
	    system's /etc/password, /etc/group files (and your system will be
	    smaller, and I will get fewer emails asking about how glibc NSS
	    works).  When this option is enabled, you will not be able to use
	    PAM to access remote LDAP password servers and whatnot.  And if you
	    want hostname resolution to work with glibc, you still need the
	    /lib/libnss_* libraries.

	    If you enable this option, it will add about 1.5k to busybox.

config USER_BUSYBOX_ADDGROUP
	bool "addgroup"
	default n
	help
	  Utility for creating a new group account.

config USER_BUSYBOX_FEATURE_ADDUSER_TO_GROUP
	bool "Support for adding users to groups"
	default n
	depends on USER_BUSYBOX_ADDGROUP
	help
	  If  called  with two non-option arguments,
	  addgroup will add an existing user to an
	  existing group.

config USER_BUSYBOX_DELGROUP
	bool "delgroup"
	default n
	help
	  Utility for deleting a group account.

config USER_BUSYBOX_FEATURE_DEL_USER_FROM_GROUP
	bool "Support for removing users from groups."
	default n
	depends on USER_BUSYBOX_DELGROUP
	help
	  If called with two non-option arguments, deluser
	  or delgroup will remove an user from a specified group.

config USER_BUSYBOX_FEATURE_CHECK_NAMES
	bool "Enable sanity check on user/group names in adduser and addgroup"
	default n
	depends on USER_BUSYBOX_ADDUSER || USER_BUSYBOX_ADDGROUP
	help
	  Enable sanity check on user and group names in adduser and addgroup.
	  To avoid problems, the user or group name should consist only of
	  letters, digits, underscores, periods, at signs and dashes,
	  and not start with a dash (as defined by IEEE Std 1003.1-2001).
	  For compatibility with Samba machine accounts "$" is also supported
	  at the end of the user or group name.

config USER_BUSYBOX_ADDUSER
	bool "adduser"
	default n
	help
	  Utility for creating a new user account.

config USER_BUSYBOX_FEATURE_ADDUSER_LONG_OPTIONS
	bool "Enable long options"
	default n
	depends on USER_BUSYBOX_ADDUSER && USER_BUSYBOX_GETOPT_LONG
	help
	  Support long options for the adduser applet.

config USER_BUSYBOX_DELUSER
	bool "deluser"
	default n
	help
	  Utility for deleting a user account.

config USER_BUSYBOX_GETTY
	bool "getty"
	default n
	select USER_BUSYBOX_FEATURE_SYSLOG
	help
	  getty lets you log in on a tty, it is normally invoked by init.

config USER_BUSYBOX_FEATURE_UTMP
	bool "Support utmp file"
	depends on USER_BUSYBOX_GETTY || USER_BUSYBOX_LOGIN || USER_BUSYBOX_SU || USER_BUSYBOX_WHO
	default n
	help
	  The file /var/run/utmp is used to track who is currently logged in.

config USER_BUSYBOX_FEATURE_WTMP
	bool "Support wtmp file"
	depends on USER_BUSYBOX_GETTY || USER_BUSYBOX_LOGIN || USER_BUSYBOX_SU || USER_BUSYBOX_LAST
	default n
	select USER_BUSYBOX_FEATURE_UTMP
	help
	  The file /var/run/wtmp is used to track when user's have logged into
	  and logged out of the system.

config USER_BUSYBOX_LOGIN
	bool "login"
	default n
	select USER_BUSYBOX_FEATURE_SUID
	select USER_BUSYBOX_FEATURE_SYSLOG
	help
	  login is used when signing onto a system.

	  Note that Busybox binary must be setuid root for this applet to
	  work properly.

config USER_BUSYBOX_PAM
	bool "Support for PAM (Pluggable Authentication Modules)"
	default n
	depends on USER_BUSYBOX_LOGIN
	help
	  Use PAM in login(1) instead of direct access to password database.

config USER_BUSYBOX_LOGIN_SCRIPTS
	bool "Support for login scripts"
	depends on USER_BUSYBOX_LOGIN
	default n
	help
	  Enable this if you want login to execute $LOGIN_PRE_SUID_SCRIPT
	  just prior to switching from root to logged-in user.

config USER_BUSYBOX_FEATURE_NOLOGIN
	bool "Support for /etc/nologin"
	default y
	depends on USER_BUSYBOX_LOGIN
	help
	  The file /etc/nologin is used by (some versions of) login(1).
	  If it exists, non-root logins are prohibited.

config USER_BUSYBOX_FEATURE_SECURETTY
	bool "Support for /etc/securetty"
	default y
	depends on USER_BUSYBOX_LOGIN
	help
	  The file /etc/securetty is used by (some versions of) login(1).
	  The file contains the device names of tty lines (one per line,
	  without leading /dev/) on which root is allowed to login.

config USER_BUSYBOX_PASSWD
	bool "passwd"
	default n
	select USER_BUSYBOX_FEATURE_SUID
	select USER_BUSYBOX_FEATURE_SYSLOG
	help
	  passwd changes passwords for user and group accounts.  A normal user
	  may only change the password for his/her own account, the super user
	  may change the password for any account.  The administrator of a group
	  may change the password for the group.

	  Note that Busybox binary must be setuid root for this applet to
	  work properly.

config USER_BUSYBOX_FEATURE_PASSWD_WEAK_CHECK
	bool "Check new passwords for weakness"
	default y
	depends on USER_BUSYBOX_PASSWD
	help
	  With this option passwd will refuse new passwords which are "weak".

config USER_BUSYBOX_CRYPTPW
	bool "cryptpw"
	default n
	help
	  Applet for crypting a string.

config USER_BUSYBOX_CHPASSWD
       bool "chpasswd"
       default n
       help
         chpasswd  reads  a  file  of user name and password pairs from
         standard input and uses this information to update a group of
         existing users.

config USER_BUSYBOX_SU
	bool "su"
	default n
	select USER_BUSYBOX_FEATURE_SUID
	select USER_BUSYBOX_FEATURE_SYSLOG
	help
	  su is used to become another user during a login session.
	  Invoked without a username, su defaults to becoming the super user.

	  Note that Busybox binary must be setuid root for this applet to
	  work properly.

config USER_BUSYBOX_FEATURE_SU_SYSLOG
	bool "Enable su to write to syslog"
	default y
	depends on USER_BUSYBOX_SU

config USER_BUSYBOX_FEATURE_SU_CHECKS_SHELLS
	bool "Enable su to check user's shell to be listed in /etc/shells"
	depends on USER_BUSYBOX_SU
	default y

config USER_BUSYBOX_SULOGIN
	bool "sulogin"
	default n
	select USER_BUSYBOX_FEATURE_SYSLOG
	help
	  sulogin is invoked when the system goes into single user
	  mode (this is done through an entry in inittab).

config USER_BUSYBOX_VLOCK
	bool "vlock"
	default n
	select USER_BUSYBOX_FEATURE_SUID
	help
	  Build the "vlock" applet which allows you to lock (virtual) terminals.

	  Note that Busybox binary must be setuid root for this applet to
	  work properly.

endmenu
```

## user/busybox/printutils/Kconfig
```kconfig
menu "Print Utilities"

config USER_BUSYBOX_LPD
	bool "lpd"
	default n
	help
	  lpd is a print spooling daemon.

config USER_BUSYBOX_LPR
	bool "lpr"
	default n
	help
	  lpr sends files (or standard input) to a print spooling daemon.

config USER_BUSYBOX_LPQ
	bool "lpq"
	default n
	help
	  lpq is a print spool queue examination and manipulation program.

endmenu
```

## user/busybox/procps/Kconfig
```kconfig
#
# For a description of the syntax of this configuration file,
# see scripts/kbuild/config-language.txt.
#

menu "Process Utilities"

config USER_BUSYBOX_FREE
	bool "free"
	default n
	help
	  free displays the total amount of free and used physical and swap
	  memory in the system, as well as the buffers used by the kernel.
	  The shared memory column should be ignored; it is obsolete.

config USER_BUSYBOX_FUSER
	bool "fuser"
	default n
	help
	  fuser lists all PIDs (Process IDs) that currently have a given
	  file open.  fuser can also list all PIDs that have a given network
	  (TCP or UDP) port open.

config USER_BUSYBOX_KILL
	bool "kill"
	default n
	help
	  The command kill sends the specified signal to the specified
	  process or process group.  If no signal is specified, the TERM
	  signal is sent.

config USER_BUSYBOX_KILLALL
	bool "killall"
	default n
	depends on USER_BUSYBOX_KILL
	help
	  killall sends a signal to all processes running any of the
	  specified commands.  If no signal name is specified, SIGTERM is
	  sent.

config USER_BUSYBOX_KILLALL5
	bool "killall5"
	default n
	depends on USER_BUSYBOX_KILL

config USER_BUSYBOX_NMETER
	bool "nmeter"
	default n
	help
	  Prints selected system stats continuously, one line per update.

config USER_BUSYBOX_PGREP
	bool "pgrep"
	default n
	help
	  Look for processes by name.

config USER_BUSYBOX_PIDOF
	bool "pidof"
	default n
	help
	  Pidof finds the process id's (pids) of the named programs. It prints
	  those id's on the standard output.

config USER_BUSYBOX_FEATURE_PIDOF_SINGLE
	bool "Enable argument for single shot (-s)"
	default n
	depends on USER_BUSYBOX_PIDOF
	help
	  Support argument '-s' for returning only the first pid found.

config USER_BUSYBOX_FEATURE_PIDOF_OMIT
	bool "Enable argument for omitting pids (-o)"
	default n
	depends on USER_BUSYBOX_PIDOF
	help
	  Support argument '-o' for omitting the given pids in output.
	  The special pid %PPID can be used to name the parent process
	  of the pidof, in other words the calling shell or shell script.

config USER_BUSYBOX_PKILL
	bool "pkill"
	default n
	help
	  Send signals to processes by name.

config USER_BUSYBOX_PS
	bool "ps"
	default n
	help
	  ps gives a snapshot of the current processes.

config USER_BUSYBOX_FEATURE_PS_WIDE
	bool "Enable argument for wide output (-w)"
	default n
	depends on USER_BUSYBOX_PS
	help
	  Support argument 'w' for wide output.
	  If given once, 132 chars are printed and given more than
	  one, the length is unlimited.

config USER_BUSYBOX_FEATURE_PS_TIME
	bool "Enable time and elapsed time output"
	default n
	depends on USER_BUSYBOX_PS && USER_BUSYBOX_DESKTOP
	help
	  Support -o time and -o etime output specifiers.

config USER_BUSYBOX_FEATURE_PS_UNUSUAL_SYSTEMS
	bool "Support Linux prior to 2.4.0 and non-ELF systems"
	default n
	depends on USER_BUSYBOX_FEATURE_PS_TIME
	help
	  Include support for measuring HZ on old kernels and non-ELF systems
	  (if you are on Linux 2.4.0+ and use ELF, you don't need this)

config USER_BUSYBOX_RENICE
	bool "renice"
	default n
	help
	  Renice alters the scheduling priority of one or more running
	  processes.

config USER_BUSYBOX_BB_SYSCTL
	bool "sysctl"
	default n
	help
	  Configure kernel parameters at runtime.

config USER_BUSYBOX_TOP
	bool "top"
	default n
	help
	  The top program provides a dynamic real-time view of a running
	  system.

config USER_BUSYBOX_FEATURE_TOP_CPU_USAGE_PERCENTAGE
	bool "Show CPU per-process usage percentage (adds 2k bytes)"
	default y
	depends on USER_BUSYBOX_TOP
	help
	  Make top display CPU usage for each process.

config USER_BUSYBOX_FEATURE_TOP_CPU_GLOBAL_PERCENTS
	bool "Show CPU global usage percentage (adds 0.5k bytes)"
	default y
	depends on USER_BUSYBOX_FEATURE_TOP_CPU_USAGE_PERCENTAGE
	help
	  Makes top display "CPU: NN% usr NN% sys..." line.

config USER_BUSYBOX_FEATURE_TOP_DECIMALS
	bool "Show 1/10th of a percent in CPU/mem statistics (adds 0.3k bytes)"
	default n
	depends on USER_BUSYBOX_FEATURE_TOP_CPU_USAGE_PERCENTAGE
	help
	  Show 1/10th of a percent in CPU/mem statistics.

config USER_BUSYBOX_FEATURE_TOPMEM
	bool "topmem"
	default n
	depends on USER_BUSYBOX_TOP
	help
	  Enable 's' in top (gives lots of memory info)

config USER_BUSYBOX_UPTIME
	bool "uptime"
	default n
	help
	  uptime gives a one line display of the current time, how long
	  the system has been running, how many users are currently logged
	  on, and the system load averages for the past 1, 5, and 15 minutes.

config USER_BUSYBOX_WATCH
	bool "watch"
	default n
	#huh?? select USER_BUSYBOX_DATE
	help
	  watch is used to execute a program periodically, showing
	  output to the screen.


endmenu
```

## user/busybox/runit/Kconfig
```kconfig
#
# For a description of the syntax of this configuration file,
# see scripts/kbuild/config-language.txt.
#

menu "Runit Utilities"

config USER_BUSYBOX_RUNSV
	bool "runsv"
	default n
	help
	  runsv starts and monitors a service and optionally an appendant log
	  service.

config USER_BUSYBOX_RUNSVDIR
	bool "runsvdir"
	default n
	help
	  runsvdir starts a runsv process for each subdirectory, or symlink to
	  a directory, in the services directory dir, up to a limit of 1000
	  subdirectories, and restarts a runsv process if it terminates.

config USER_BUSYBOX_SV
	bool "sv"
	default n
	help
	  sv reports the current status and controls the state of services
	  monitored by the runsv supervisor.

config USER_BUSYBOX_SVLOGD
	bool "svlogd"
	default n
	help
	  svlogd continuously reads log data from its standard input, optionally
	  filters log messages, and writes the data to one or more automatically
	  rotated logs.

config USER_BUSYBOX_CHPST
	bool "chpst"
	default n
	help
	  chpst changes the process state according to the given options, and
	  execs specified program.

config USER_BUSYBOX_SETUIDGID
	bool "setuidgid"
	help
	  Sets soft resource limits as specified by options

config USER_BUSYBOX_ENVUIDGID
	bool "envuidgid"
	help
	  Sets $UID to account's uid and $GID to account's gid

config USER_BUSYBOX_ENVDIR
	bool "envdir"
	help
	  Sets various environment variables as specified by files
	  in the given directory

config USER_BUSYBOX_SOFTLIMIT
	bool "softlimit"
	help
	  Sets soft resource limits as specified by options

endmenu
```
