## user/busybox/selinux/Kconfig
```kconfig
#
# For a description of the syntax of this configuration file,
# see scripts/kbuild/config-language.txt.
#

menu "Selinux Utilities"
	depends on USER_BUSYBOX_SELINUX

config USER_BUSYBOX_CHCON
	bool "chcon"
	default n
	depends on USER_BUSYBOX_SELINUX
	help
	  Enable support to change the security context of file.

config USER_BUSYBOX_FEATURE_CHCON_LONG_OPTIONS
	bool "Enable long options"
	default y
	depends on USER_BUSYBOX_CHCON && USER_BUSYBOX_GETOPT_LONG
	help
	  Support long options for the chcon applet.

config USER_BUSYBOX_GETENFORCE
	bool "getenforce"
	default n
	depends on USER_BUSYBOX_SELINUX
	help
	  Enable support to get the current mode of SELinux.

config USER_BUSYBOX_GETSEBOOL
	bool "getsebool"
	default n
	depends on USER_BUSYBOX_SELINUX
	help
	  Enable support to get SELinux boolean values.

config USER_BUSYBOX_LOAD_POLICY
	bool "load_policy"
	default n
	depends on USER_BUSYBOX_SELINUX
	help
	  Enable support to load SELinux policy.

config USER_BUSYBOX_MATCHPATHCON
	bool "matchpathcon"
	default n
	depends on USER_BUSYBOX_SELINUX
	help
	  Enable support to get default security context of the
	  specified path from the file contexts configuration.

config USER_BUSYBOX_RESTORECON
	bool "restorecon"
	default n
	depends on USER_BUSYBOX_SELINUX
	help
	  Enable support to relabel files. The feature is almost
	  the same as setfiles, but usage is a little different.

config USER_BUSYBOX_RUNCON
	bool "runcon"
	default n
	depends on USER_BUSYBOX_SELINUX
	help
	  Enable support to run command in speficied security context.

config USER_BUSYBOX_FEATURE_RUNCON_LONG_OPTIONS
	bool "Enable long options"
	default y
	depends on USER_BUSYBOX_RUNCON && USER_BUSYBOX_GETOPT_LONG
	help
	  Support long options for the runcon applet.

config USER_BUSYBOX_SELINUXENABLED
	bool "selinuxenabled"
	default n
	depends on USER_BUSYBOX_SELINUX
	help
	  Enable support for this command to be used within shell scripts
	  to determine if selinux is enabled.

config USER_BUSYBOX_SETENFORCE
	bool "setenforce"
	default n
	depends on USER_BUSYBOX_SELINUX
	help
	  Enable support to modify the mode SELinux is running in.

config USER_BUSYBOX_SETFILES
	bool "setfiles"
	default n
	depends on USER_BUSYBOX_SELINUX
	help
	  Enable support to modify to relabel files.
	  Notice: If you built libselinux with -D_FILE_OFFSET_BITS=64,
	  (It is default in libselinux's Makefile), you _must_ enable
	  CONFIG_LFS.

config USER_BUSYBOX_FEATURE_SETFILES_CHECK_OPTION
	bool "Enable check option"
	default n
	depends on USER_BUSYBOX_SETFILES
	help
	  Support "-c" option (check the validity of the contexts against
	  the specified binary policy) for setfiles. Requires libsepol.

config USER_BUSYBOX_SETSEBOOL
	bool "setsebool"
	default n
	depends on USER_BUSYBOX_SELINUX
	help
	  Enable support for change boolean.
	  semanage and -P option is not supported yet.

config USER_BUSYBOX_SESTATUS
	bool "sestatus"
	default n
	depends on USER_BUSYBOX_SELINUX
	help
	  Displays the status of SELinux.

endmenu
```

## user/lua/Kconfig
```kconfig
config USER_LUA
  bool "lua"
  help
     The lua programming language compiler and interpreter.
     See http://www.lua.org/

config USER_LUA_LUAROCKS
  bool "lua: luarocks"
  depends on USER_LUA
  default n
  help
	 Everything lua can come via this package

config USER_LUA_ORBIT
  bool "lua: orbit"
  depends on USER_LUA_LUAROCKS
  default n
  help
     MVC web frameowrk for lua.

config USER_LUA_LUASQL_SQLITE3
  bool "lua: luasql-sqlite3"
  depends on USER_LUA_LUAROCKS
  default n
  help
     Luasql-sqlite3

config USER_LUA_WSAPI
  bool "lua: wsapi"
  depends on USER_LUA_LUAROCKS
  default n
  help
     WSAPI

config USER_LUA_WSAPI_XAVANTE
  bool "lua: wsapi-xavante"
  depends on USER_LUA_LUAROCKS
  default n
  help
     WSAPI Xavante

config USER_LUA_XAVANTE
  bool "lua: xavante"
  depends on USER_LUA_LUAROCKS
  default n
  help
     Xavante web server

config USER_LUA_COSMO
  bool "lua: cosmo"
  depends on USER_LUA_LUAROCKS
  default n
  help
     Cosmo is a “safe templates” engine.
```
